## config/boards/shields/quye/Kconfig.defconfig
```kconfig
if SHIELD_QUYE_LEFT

config ZMK_KEYBOARD_NAME
    default "Quye"

config ZMK_SPLIT_ROLE_CENTRAL
    default y

endif

if SHIELD_QUYE_LEFT || SHIELD_QUYE_RIGHT

config ZMK_SPLIT
    default y

endif
```

## config/boards/shields/quye/Kconfig.shield
```kconfig
# Copyright (c) 2020 The ZMK Contributors
# SPDX-License-Identifier: MIT

config SHIELD_QUYE_LEFT
	def_bool $(shields_list_contains,quye_left)

config SHIELD_QUYE_RIGHT
	def_bool $(shields_list_contains,quye_right)
```
