#include "quye.dtsi"

&default_transform { // The matrix transform for this board is 6 columns over because the left half is 6 columns wide according to the matrix.
    col-offset = <7>;
};

&kscan0 {
    col-gpios
        = <&pro_micro 9 GPIO_ACTIVE_HIGH> // col7 in the schematic
        , <&pro_micro 6 GPIO_ACTIVE_HIGH> // col8 in the schematic
        , <&pro_micro 5 GPIO_ACTIVE_HIGH> // col9 in the schematic
        , <&pro_micro 4 GPIO_ACTIVE_HIGH> // col10 in the schematic
        , <&pro_micro 2 GPIO_ACTIVE_HIGH> // col11 in the schematic
        , <&pro_micro 0 GPIO_ACTIVE_HIGH> // col12 in the schematic
        , <&pro_micro 1 GPIO_ACTIVE_HIGH> // col3 in the schematic
        ;
};

&right_encoder {
    status = "okay";
};


&right_encoder2 {
    status = "okay";
};
